## configs/CHIP_defconfig
```kconfig
CONFIG_ARM=y
CONFIG_ARCH_SUNXI=y
CONFIG_MACH_SUN5I=y
CONFIG_DRAM_TIMINGS_DDR3_800E_1066G_1333J=y
# CONFIG_MMC is not set
CONFIG_USB0_VBUS_PIN="PB10"
CONFIG_AXP_GPIO=y
# CONFIG_VIDEO_HDMI is not set
CONFIG_VIDEO_COMPOSITE=y
CONFIG_VIDEO_LCD_MODE="x:1024,y:768,depth:18,pclk_khz:65000,le:44,ri:140,up:23,lo:9,hs:136,vs:6,sync:3,vmode:0"
CONFIG_VIDEO_LCD_POWER="AXP0-1"
CONFIG_VIDEO_LCD_BL_PWM="PB2"
CONFIG_DEFAULT_DEVICE_TREE="sun5i-r8-chip"
CONFIG_SPL=y
CONFIG_SYS_EXTRA_OPTIONS="CONS_INDEX=2,AXP209_POWER,ENV_IS_IN_NAND,SPLASH_SCREEN_ALIGN,CMD_BMP,VIDEO_BMP_LOGO"
# CONFIG_CMD_IMLS is not set
CONFIG_NAND_SUNXI=y
CONFIG_SYS_NAND_U_BOOT_OFFS=0x800000
CONFIG_AXP_ALDO3_VOLT=3300
CONFIG_AXP_ALDO4_VOLT=3300
CONFIG_USB_MUSB_GADGET=y
```
